## recipes/conf/layer.conf
```bitbake
BBFILES += "${LAYERDIR}/recipes/*/*.bb \
            ${LAYERDIR}/recipes/*/*.bbappend"
BBPATH .= ":${LAYERDIR}"
BBFILE_COLLECTIONS += "openbenchmarks"
BBFILE_PRIORITY_openbenchmarks = "15"
BBFILE_PATTERN_openbenchmarks = "^${LAYERDIR}/"
```
